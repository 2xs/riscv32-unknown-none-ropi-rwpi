ENTRY(main)

SECTIONS {
  . = __TEXT_RUNTIME_BASE__;
  .text : ALIGN(4) {
    __text_start = .;
    *(.text .text.*)
    *(.rodata .rodata.*)
    *(.srodata .srodata.*)
    __text_end = .;
  }

  . = __LINKED_DATA_BASE__;
  __gp_data_start = .;

  .dataramro : ALIGN(4) {
    __dataramro_start = .;
    *(.dataramro .dataramro.*)
    *(.ramro .ramro.*)
    __dataramro_end = .;
  }

  .datarw : ALIGN(4) {
    __datarw_start = .;
    *(.data .data.*)
    *(.sdata .sdata.*)
    __datarw_end = .;
  }

  .datarw.bss (NOLOAD) : ALIGN(4) {
    __datarw_bss_start = .;
    *(.bss .bss.*)
    *(.sbss .sbss.*)
    *(COMMON)
    __datarw_bss_end = .;
  }

  /DISCARD/ : {
    *(.comment)
    *(.note.GNU-stack)
    *(.riscv.attributes)
  }
}
